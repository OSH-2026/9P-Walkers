## pwos-master-esp32p4/sdkconfig.defaults
```kconfig
CONFIG_ESPTOOLPY_FLASHFREQ_80M=y
CONFIG_ESP32P4_SELECTS_REV_LESS_V3=y
# CONFIG_ESP32P4_REV_MIN_301 is not set
CONFIG_ESP32P4_REV_MIN_100=y
# CONFIG_ESP_CONSOLE_UART_DEFAULT is not set
CONFIG_ESP_CONSOLE_USB_SERIAL_JTAG=y
CONFIG_ESP_CONSOLE_SECONDARY_NONE=y
# CONFIG_ESP_CONSOLE_SECONDARY_USB_SERIAL_JTAG is not set
CONFIG_HTTPD_WS_SUPPORT=y
CONFIG_ESPTOOLPY_FLASHSIZE_16MB=y
CONFIG_ESPTOOLPY_FLASHSIZE="16MB"
CONFIG_PARTITION_TABLE_CUSTOM=y
CONFIG_PARTITION_TABLE_CUSTOM_FILENAME="partitions.csv"
CONFIG_SPIRAM=y
CONFIG_SPIRAM_MODE_HEX=y
CONFIG_SPIRAM_SPEED_80M=y
CONFIG_SPIRAM_BOOT_INIT=y
CONFIG_SPIRAM_USE_MALLOC=y
CONFIG_SPIRAM_MALLOC_ALWAYSINTERNAL=16384
CONFIG_SPIRAM_MALLOC_RESERVE_INTERNAL=65536
CONFIG_SPIRAM_TRY_ALLOCATE_WIFI_LWIP=y
CONFIG_COMPILER_OPTIMIZATION_PERF=y
```

## pwos-master-esp32s3/main/Kconfig.projbuild
```kconfig
menu "9P-Walkers ESP32-S3"

config PWOS_WIFI_SSID
    string "WiFi SSID"
    default "pwos-network"

config PWOS_WIFI_PASSWORD
    string "WiFi password"
    default "pwos-network"

config PWOS_S3_UART_PORT
    int "STM32 UART port"
    range 1 2
    default 1

config PWOS_S3_UART_TX_GPIO
    int "STM32 UART TX GPIO"
    range 0 48
    default 17

config PWOS_S3_UART_RX_GPIO
    int "STM32 UART RX GPIO"
    range 0 48
    default 18

config PWOS_S3_UART_BAUD_RATE
    int "STM32 UART baud rate"
    range 115200 5000000
    default 1000000

endmenu
```

## pwos-master-esp32s3/sdkconfig.defaults
```kconfig
CONFIG_ESPTOOLPY_FLASHSIZE_16MB=y
CONFIG_PARTITION_TABLE_CUSTOM=y
CONFIG_PARTITION_TABLE_CUSTOM_FILENAME="partitions.csv"
CONFIG_ESP_DEFAULT_CPU_FREQ_MHZ_240=y
CONFIG_COMPILER_OPTIMIZATION_PERF=y
CONFIG_SPIRAM=y
CONFIG_SPIRAM_MODE_OCT=y
CONFIG_SPIRAM_TYPE_AUTO=y
CONFIG_SPIRAM_SPEED_80M=y
CONFIG_SPIRAM_BOOT_INIT=y
CONFIG_SPIRAM_USE_MALLOC=y
CONFIG_SPIRAM_MALLOC_ALWAYSINTERNAL=16384
CONFIG_SPIRAM_MALLOC_RESERVE_INTERNAL=65536
CONFIG_SPIRAM_TRY_ALLOCATE_WIFI_LWIP=y
```
